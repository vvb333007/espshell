static const char *Error_No_Manual = "\r\n"
  "%% Извините, для \"%s\" справка отсутствует\r\n"
  "%% Введите \"<i>?</>\" и нажмите <Enter>, чтобы увидеть доступные команды\r\n";


static const char *List_Banner = 
  "% Введите \"<b>?</> <i>КОМАНДА</>\", чтобы посмотреть описание конкретной команды.\r\n"
  "% Введите \"<b>? <i>keys</>\", чтобы открыть справку по клавиатуре ESPShell.\r\n"
  "%\r\n";


static const char *Hints[] = {

"% Нажимайте <TAB> несколько раз, чтобы перемещать курсор по аргументам команды.\r\n"
"% Это быстрее, чем использовать стрелки (<-- и -->).",

"% Клавиши <HOME> и <END> не работают? Используйте Ctrl+A вместо <HOME> и\r\n"
"% Ctrl+E вместо <END>. Подробнее см. справку по клавишам ESPShell: \"? keys\"",

"% Нажмите <ESC>, затем введите число и снова нажмите <ESC>, чтобы ввести символ\r\n"
"% по его коду: <ESC>, 32, <ESC> отправляет \"пробел\" (код 32).",

"% Нажатие <ESC>, а затем <BACKSPACE> удаляет одно слово, а не один символ.",

"% Используйте команду \"colors off\", если ваш терминал не поддерживает ANSI-цвета.",

"% Используйте команду \"history off\", чтобы отключить историю команд\r\n"
"% и очистить уже сохранённые записи.",

"% Команда \"uptime\" также показывает причину последней перезагрузки (краша).",

"% Команда \"suspend\" (или Ctrl+C) приостанавливает выполнение скетча.\r\n"
"% Возобновить выполнение можно командой \"resume\".",

"% Вы можете использовать Ctrl+Z как сокращение для команды \"exit\".",

"% Имена команд и их аргументы можно сокращать: \"suspend\" можно написать как \"su\",\r\n"
"% а \"pin 2 in out open\" — как \"p 2 i o op\".",

"% Чтобы смонтировать файловую систему на разделе \"FancyName\", введите \"mount F\".\r\n"
"% Сокращения также работают для аргументов команды \"unmount\".",

"% У команды \"unmount\" есть псевдоним: \"umount\".",

"% Команда \"mkdir\" создаёт все отсутствующие каталоги в указанном пути.",

"% Команда \"touch\" создаёт все отсутствующие каталоги в пути перед созданием файла.",

"% Используйте \"var ls_show_dir_size 0\", чтобы отключить подсчёт размеров каталогов\r\n"
"% в команде \"ls\": файловые системы с большим числом файлов могут работать медленно.",

"% Чтобы использовать пробелы в именах файлов, замените их звёздочкой (*): \"mkdir A*Path\",\r\n"
"% либо просто используйте двойные кавычки (\"\"): mkdir \"A Path\"\r\n",

"% Основные команды доступны в любом подкаталоге команд:\r\n"
"% вы можете выполнять команду \"pin\", находясь в режиме настройки UART,\r\n"
"% без необходимости выполнять \"exit\".",

"% Вы можете передавать файлы по UART, используя команду \"cat\" файловой системы.",

"% Нажмите Ctrl+R для поиска по истории команд: начните ввод и нажмите <Enter>,\r\n"
"% чтобы найти ранее введённую подходящую команду.",

"% Используйте символ \"^\" при поиске по истории (Ctrl+R), чтобы искать\r\n"
"% совпадения с начала строки (аналогично регулярному выражению \"^\").",

"% Нажмите Ctrl+L, чтобы очистить экран и включить цвета терминала.",

"% Добавление символа \"&\" в конце любой команды запускает её в фоне,\r\n"
"% как в Bash/Linux: \"count 4 &\".",

"% Команда \"if\" может использоваться для задания условий по GPIO\r\n"
"% и соответствующих действий, например: \"if rising 2 exec my_alias\".",

"% Команда \"every\" позволяет планировать периодические задачи\r\n"
"% (с задержкой или немедленно), например: \"every 2 hours exec my_alias\".",

"% Команда \"if\" также может использоваться для опроса значений GPIO:\r\n"
"% \"if low 4 high 5 poll 1000 exec my_alias\".",

"% Нажмите @ в начале строки ввода, чтобы скрыть вводимые данные.\r\n"
"% После нажатия <Enter> оболочка вернётся в обычный режим.",

"% Просматривать и редактировать ключи и значения NVS можно с помощью\r\n"
"% редактора NVS (команда \"nvs\").",

"% Вы можете синхронизировать системное время командой WiFi:\r\n"
"% \"ntp enable\".",

"% Используйте команду \"nat enable\", чтобы включить NAT-маршрутизатор\r\n"
"% на WiFi-интерфейсе точки доступа (AP).",

};


static const char *Keys_Manual = "% \r\n"
  "%           -- Клавиши ESPShell -- \r\n"
  "%\r\n"
  "% <ENTER>         : Выполнить команду\r\n"
  "% <- ->           : Стрелки: перемещение курсора влево/вправо. Вверх и вниз —\r\n"
  "%                   прокрутка истории команд\r\n"
  "% <DEL>           : Как в Notepad\r\n"
  "% <BACKSPACE>     : Как в Notepad\r\n"
  "% <HOME>, <END>   : Вместо <HOME> используйте Ctrl+A, вместо <END> — Ctrl+E\r\n"
  "% <TAB>           : Перейти к следующему слову/аргументу. Нажимайте <TAB>\r\n"
  "%                   несколько раз для перебора слов в строке\r\n"
  "% Ctrl+R          : Поиск по истории команд\r\n"
  "% Ctrl+K          : Очистить строку от курсора до конца\r\n"
  "% Ctrl+L          : Очистить экран\r\n"
  "% Ctrl+Z          : То же самое, что ввод команды \"exit\"\r\n"
  "% Ctrl+C          : Приостановить выполнение скетча\r\n"
  "% <ESC>,NUM,<ESC> : То же самое, что ввод символа с десятичным ASCII-кодом NUM\r\n"
  "%\r\n"
  "% -- Обходные решения для совместимости терминалов (альтернативные сочетания) --\r\n"
  "%\r\n"
  "% Ctrl+B и Ctrl+F : Работают как \"<-\" и \"->\" ([B]ack и [F]orward)\r\n"
  "% Ctrl+O или P    : Перемещение по истории команд: O — назад, P — вперёд\r\n"
  "% Ctrl+D          : Работает как клавиша <DEL>\r\n"
  "% Ctrl+H          : Работает как клавиша <BACKSPACE>\r\n";
